## app/west.yml
```yaml
manifest:
  projects:
    - name: zmk
      url: https://github.com/innovaker/zmk
      revision: modular
      import: true
    - name: harmless-zmk-shield
      url: https://github.com/innovaker2/harmless-zmk-shield
      revision: master
      import: true
```

## west.yml
```yaml
manifest:
  projects:
    - name: zmk
      url: https://github.com/innovaker/zmk
      revision: modular-v2
      import: true
    - name: harmless-zmk-shield
      url: https://github.com/innovaker2/harmless-zmk-shield
      revision: master-v2
      import: true
```
